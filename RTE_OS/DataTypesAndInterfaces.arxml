AUTOSAR XML (schema 4-3-0)
package /test/DataTypes
  4 x app type:
    Boolean
    float
    UnsignedInteger_8
    SignedInteger_8
package /test/PortInterfaces
  sender receiver interface SR1
    data SR1_DE1: type=Boolean
    data SR1_DE2: type=float
    data SR1_DE3: type=UnsignedInteger_8
  sender receiver interface SR2
    data SR2_DE1: type=Boolean
    data SR2_DE2: type=SignedInteger_8
    data SR2_DE3: type=float
  client server interface CS1
    client-server-operation:
      arg arg1: type=Boolean, direction=input
      arg arg2: type=UnsignedInteger_8, direction=input
      arg arg3: type=float, direction=input/output
  client server interface CS2
    client-server-operation:
      arg A1: type=float, direction=input
      arg A2: type=SignedInteger_8, direction=input/output
      arg A3: type=float, direction=output
    client-server-operation:
      arg AR1: type=SignedInteger_8, direction=output
      arg AR2: type=UnsignedInteger_8, direction=input/output
      arg AR3: type=float, direction=input/output
